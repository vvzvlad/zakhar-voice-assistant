## firmware/main/Kconfig.projbuild
```kconfig
menu "zakhar"

config ZAKHAR_WIFI_SSID
    string "Wi-Fi SSID of the one-time seed image"
    default ""
    help
        Set only in the image of `make fw-build-seed` (from sdkconfig.secrets). A device with no
        stored network stores this one and connects; empty, it starts BLE provisioning.

config ZAKHAR_WIFI_PASSWORD
    string "Wi-Fi password of the one-time seed image"
    default ""

endmenu
```
